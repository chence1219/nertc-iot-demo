## esp32/nertc_demo/main/boards/lichuang-dev/sdkconfig.defaults.board
```kconfig
CONFIG_BOARD_TYPE_LICHUANG_DEV_S3=y
CONFIG_SPIRAM_TRY_ALLOCATE_WIFI_LWIP=y
CONFIG_SPIRAM_ALLOW_BSS_SEG_EXTERNAL_MEMORY=y
CONFIG_SPIRAM_ALLOW_NOINIT_SEG_EXTERNAL_MEMORY=y
CONFIG_SPIRAM_MALLOC_ALWAYSINTERNAL=0
CONFIG_SPIRAM_MALLOC_RESERVE_INTERNAL=65536
```

## esp32/nertc_demo/third_party/blufi_app/main/Kconfig.projbuild
```kconfig
menu "YunXin config"

choice BOARD_TYPE
    prompt "Board Type"
    default BOARD_TYPE_GENERIC_SAFE
    help
        Board type. 开发板类型
    config BOARD_TYPE_GENERIC_SAFE
        bool "Generic Safe (No GPIO/LCD/Button)"
        depends on IDF_TARGET_ESP32S3
    config BOARD_TYPE_ZHENGCHEN_QUDOU
        bool "征辰科技-趣逗"
        depends on IDF_TARGET_ESP32S3
    config BOARD_TYPE_ZUOWEI
        bool "佐为"
        depends on IDF_TARGET_ESP32S3
endchoice

endmenu
```
